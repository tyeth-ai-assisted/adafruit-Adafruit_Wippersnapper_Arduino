## tests/hil/mcp9601/esp32s31/main/Kconfig.projbuild
```kconfig
menu "MCP9601 HIL"
    config MCP_HIL_I2C_PORT
        int "Exclusive test-bus I2C peripheral index (NOT the analogue mux bus)"
        range 0 1
        default 1
    config MCP_HIL_SCL_GPIO
        int "Test-bus SCL output GPIO (Arduino default)"
        range -1 61
        default 3
    config MCP_HIL_SDA_GPIO
        int "Test-bus SDA output GPIO (Arduino default)"
        range -1 61
        default 2
    config MCP_HIL_SNIFF_SCL_GPIO
        int "Independent high-impedance SCL RMT observer GPIO (J2 pin 20 on CoreBoard-1)"
        range -1 61
        default 42
    config MCP_HIL_SNIFF_SDA_GPIO
        int "Independent high-impedance SDA RMT observer GPIO (J2 pin 17 on CoreBoard-1)"
        range -1 61
        default 43
    config MCP_HIL_MCP_ADDRESS
        int "7-bit MCP9601 address, decimal (103 = 0x67)"
        range 8 119
        default 103
    config MCP_HIL_SPEED_HZ
        int "Test-bus I2C clock in Hz"
        range 10000 100000
        default 100000
endmenu
```
